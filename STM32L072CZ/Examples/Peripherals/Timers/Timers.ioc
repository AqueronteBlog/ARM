# file: Timers.ioc
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Mcu.Family=STM32L0
Mcu.Name=STM32L072C(B-Z)Yx
Mcu.Package=WLCSP49
ProjectManager.HeapSize=0x200
ProjectManager.StackSize=0x400
ProjectManager.TargetToolchain=STM32CubeIDE
RCC.AHBFreq_Value=2097000
RCC.APB1Freq_Value=2097000
RCC.APB1TimFreq_Value=2097000
RCC.APB2Freq_Value=2097000
RCC.APB2TimFreq_Value=2097000
RCC.HSE_VALUE=8000000
RCC.HSI16_VALUE=16000000
RCC.HSI48_VALUE=48000000
RCC.HSI_VALUE=16000000
RCC.LSE_VALUE=32768
RCC.MSI_VALUE=2097000
RCC.SYSCLKFreq_VALUE=2097000
RCC.VCOOutputFreq_Value=48000000
board=custom

// file: Core/Src/main.c
/* USER CODE BEGIN Header */
/**
 * @brief       main.c
 * @details     This example shows how to work with the Timer peripherals.
 * 					LED1: Every   1s	( TIM2, interrupt mode ).
 * 					LED2: Every   2s	( TIM6, interrupt mode ).
 * 					LED3: Every 0.5s	( TIM7, polling mode ).
 *
 *
 * @return      N/A
 *
 * @author      Manuel Caballero
 * @date        01/October/2019
 * @version     01/October/2019   The ORIGIN
 * @pre         This firmware was tested on the B-L072Z-LRWAN1 board with STM32CubeIDE vs1.0.2. This project was generated using
 * 				SMT32CubeMX ( just to generate a template ).
 * @warning     Although HAL driver was generated, just the Low Power functions are used.
 */
/**
  ******************************************************************************
  * @file           : main.c
  * @brief          : Main program body
  ******************************************************************************
  * @attention
  *
  * <h2><center>&copy; Copyright (c) 2019 STMicroelectronics.
  * All rights reserved.</center></h2>
  *
  * This software component is licensed by ST under BSD 3-Clause license,
  * the "License"; You may not use this file except in compliance with the
  * License. You may obtain a copy of the License at:
  *                        opensource.org/licenses/BSD-3-Clause
  *
  ******************************************************************************
  */
/* USER CODE END Header */

#include "main.h"

/* USER CODE BEGIN Includes */
#include "variables.h"
#include "functions.h"
#include "interrupts.h"

/* USER CODE END Includes */

/* USER CODE BEGIN PD */
#define SYSTEM_CORE_CLK		2097000U
#define TIMER_TIM2_CLK		SYSTEM_CORE_CLK
#define TIMER_TIM6_CLK		SYSTEM_CORE_CLK
#define TIMER_TIM7_CLK		SYSTEM_CORE_CLK

/* USER CODE END PD */

void SystemClock_Config(void);

int main(void)
{

  /* MCU Configuration--------------------------------------------------------*/

  /* Reset of all peripherals, Initializes the Flash interface and the Systick. */
  HAL_Init();

  /* Configure the system clock */
  SystemClock_Config();

  /* Initialize all configured peripherals */
  /* USER CODE BEGIN 2 */
  Conf_GPIO 	 ();
  Conf_TimerTIM2 ( TIMER_TIM2_CLK );
  Conf_TimerTIM6 ( TIMER_TIM6_CLK );
  Conf_TimerTIM7 ( TIMER_TIM7_CLK );

  /* USER CODE END 2 */

  /* Infinite loop */
  /* USER CODE BEGIN WHILE */
  TIM2->CR1	|=	 TIM_CR1_CEN;		// Enable Timer TIM2
  TIM6->CR1	|=	 TIM_CR1_CEN;		// Enable Timer TIM6
  TIM7->CR1	|=	 TIM_CR1_CEN;		// Enable Timer TIM7
  while (1)
  {
	  /* Wait until TIM7 overflows	 */
	  while ( ( TIM7->SR & TIM_SR_UIF_Msk ) != TIM_SR_UIF );
	  /* Clear flag	 */
	  TIM7->SR	&=	~TIM_SR_UIF;

	  /* Check last status of the LED3	 */
	  if ( ( GPIOB->ODR & ( 1 << LD3 ) ) == ( 1 << LD3 ) )
	  {
		  GPIOB->BRR	=	( 1 << LD3 );		// Turn it OFF
	  }
	  else
	  {
		  GPIOB->BSRR	=	( 1 << LD3 );		// Turn it ON
	  }

    /* USER CODE END WHILE */

  }
}

void SystemClock_Config(void)
{
  RCC_OscInitTypeDef RCC_OscInitStruct = {0};
  RCC_ClkInitTypeDef RCC_ClkInitStruct = {0};

  /** Configure the main internal regulator output voltage
  */
  __HAL_PWR_VOLTAGESCALING_CONFIG(PWR_REGULATOR_VOLTAGE_SCALE1);
  /** Initializes the CPU, AHB and APB busses clocks
  */
  RCC_OscInitStruct.OscillatorType = RCC_OSCILLATORTYPE_MSI;
  RCC_OscInitStruct.MSIState = RCC_MSI_ON;
  RCC_OscInitStruct.MSICalibrationValue = 0;
  RCC_OscInitStruct.MSIClockRange = RCC_MSIRANGE_5;
  RCC_OscInitStruct.PLL.PLLState = RCC_PLL_NONE;
  if (HAL_RCC_OscConfig(&RCC_OscInitStruct) != HAL_OK)
  {
    Error_Handler();
  }
  /** Initializes the CPU, AHB and APB busses clocks
  */
  RCC_ClkInitStruct.ClockType = RCC_CLOCKTYPE_HCLK|RCC_CLOCKTYPE_SYSCLK
                              |RCC_CLOCKTYPE_PCLK1|RCC_CLOCKTYPE_PCLK2;
  RCC_ClkInitStruct.SYSCLKSource = RCC_SYSCLKSOURCE_MSI;
  RCC_ClkInitStruct.AHBCLKDivider = RCC_SYSCLK_DIV1;
  RCC_ClkInitStruct.APB1CLKDivider = RCC_HCLK_DIV1;
  RCC_ClkInitStruct.APB2CLKDivider = RCC_HCLK_DIV1;

  if (HAL_RCC_ClockConfig(&RCC_ClkInitStruct, FLASH_LATENCY_0) != HAL_OK)
  {
    Error_Handler();
  }
}

void Error_Handler(void)
{
}

/************************ (C) COPYRIGHT STMicroelectronics *****END OF FILE****/
